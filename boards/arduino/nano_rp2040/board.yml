## boards/arduino/nano_rp2040/nano_rp2040_defconfig
```kconfig
CONFIG_SYS_CLOCK_HW_CYCLES_PER_SEC=125000000
CONFIG_SERIAL=y
CONFIG_CONSOLE=y
CONFIG_UART_CONSOLE=y
CONFIG_GPIO=y
CONFIG_USE_DT_CODE_PARTITION=y
CONFIG_BUILD_OUTPUT_UF2=y
CONFIG_BUILD_OUTPUT_HEX=y
CONFIG_UART_INTERRUPT_DRIVEN=y
CONFIG_RESET=y
CONFIG_CLOCK_CONTROL=y
#CONFIG_USB=y
CONFIG_USB_DEVICE_STACK=y
CONFIG_USB_DFU_CLASS=y
#CONFIG_DFU_TARGET=y
CONFIG_USB_DEVICE_PRODUCT="Arduino Nano RP2040 Connect"
#CONFIG_MAIN_STACK_SIZE=4096
```
